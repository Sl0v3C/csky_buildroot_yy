## configs/csky_gx6605s_fbcon_defconfig
```kconfig
BR2_csky=y
BR2_OPTIMIZE_2=y
BR2_GLOBAL_PATCH_DIR="board/nationalchip/gx66xx/patches"
BR2_TOOLCHAIN_EXTERNAL_GDB_SERVER_COPY=y
BR2_TARGET_GENERIC_GETTY_PORT="tty0"
#BR2_ROOTFS_OVERLAY="board/nationalchip/gx66xx/fs-overlay/"
BR2_ROOTFS_POST_IMAGE_SCRIPT="board/nationalchip/gx66xx/post-image.sh"
BR2_LINUX_KERNEL=y
BR2_LINUX_KERNEL_CUSTOM_VERSION=y
BR2_LINUX_KERNEL_CUSTOM_VERSION_VALUE="4.9.25"
BR2_LINUX_KERNEL_DEFCONFIG="gx66xx"
BR2_LINUX_KERNEL_DTS_SUPPORT=y
BR2_LINUX_KERNEL_INTREE_DTS_NAME="gx6605s"
BR2_LINUX_KERNEL_EXT_CSKY_ARCH=y
BR2_LINUX_KERNEL_EXT_CSKY_ARCH_VERSION="2b45a8c810e5d4810b3daff21ce6929e9e28f828"
BR2_LINUX_KERNEL_EXT_CSKY_ADDONS=y
BR2_LINUX_KERNEL_EXT_CSKY_ADDONS_VERSION="4d8cf67c57ab2d70dfb7e5908fe0e9b6199c8a71"
BR2_PACKAGE_LINUX_FIRMWARE=y
BR2_PACKAGE_LINUX_FIRMWARE_MEDIATEK_MT7601U=y
BR2_PACKAGE_EVTEST=y
####### Modified by pyy START #######
#BR2_PACKAGE_PYTHON=y
#BR2_PACKAGE_PYTHON_GPIO=y
####### Modified by pyy END #######
BR2_PACKAGE_IW=y
BR2_PACKAGE_WIRELESS_TOOLS=y
BR2_PACKAGE_WIRELESS_TOOLS_LIB=y
BR2_PACKAGE_WPA_SUPPLICANT=y
BR2_PACKAGE_WPA_SUPPLICANT_AUTOSCAN=y
BR2_PACKAGE_WPA_SUPPLICANT_EAP=y
BR2_PACKAGE_WPA_SUPPLICANT_CLI=y
BR2_PACKAGE_WPA_SUPPLICANT_WPA_CLIENT_SO=y
BR2_PACKAGE_WPA_SUPPLICANT_PASSPHRASE=y
BR2_TARGET_ROOTFS_EXT2=y
BR2_TARGET_ROOTFS_EXT2_4=y
BR2_PACKAGE_HOST_DOSFSTOOLS=y
BR2_PACKAGE_HOST_GENIMAGE=y
BR2_PACKAGE_HOST_MTOOLS=y
BR2_PACKAGE_HOST_CSKY_DEBUG=y

####### Added by pyy #######
BR2_PACKAGE_BUSYBOX_SHOW_OTHERS=y
BR2_PACKAGE_SUDO=y
BR2_TARGET_GENERIC_HOSTNAME="c-sky_gx6605s"
BR2_TARGET_GENERIC_ISSUE="Welcome to C-SKY!"
BR2_TARGET_GENERIC_ROOT_PASSWD="admin"
BR2_PACKAGE_PYTHON3=y
BR2_PACKAGE_PYTHON3_PYC_ONLY=y
BR2_PACKAGE_PYTHON3_SSL=y
BR2_PACKAGE_PYTHON3_BZIP2=y
BR2_PACKAGE_PYTHON3_CODECSCJK=y
BR2_PACKAGE_PYTHON3_CURSES=y
BR2_PACKAGE_PYTHON3_DECIMAL=y
BR2_PACKAGE_PYTHON3_OSSAUDIODEV=y
BR2_PACKAGE_PYTHON3_READLINE=y
BR2_PACKAGE_PYTHON3_SQLITE=y
BR2_PACKAGE_PYTHON3_XZ=y
BR2_PACKAGE_PYTHON_ATTRS=y
BR2_PACKAGE_PYTHON_CFFI=y
BR2_PACKAGE_PYTHON_CRYPTOGRAPHY=y
BR2_PACKAGE_PYTHON_HTML5LIB=y
BR2_PACKAGE_PYTHON_HTTPLIB2=y
BR2_PACKAGE_PYTHON_IDNA=y
BR2_PACKAGE_PYTHON_MARKDOWN2=y
BR2_PACKAGE_PYTHON_PYASN=y
BR2_PACKAGE_PYTHON_PYOPENSSL=y
BR2_PACKAGE_PYTHON_REQUESTS=y
BR2_PACKAGE_PYTHON_REQUESTS_TOOLBELT=y
BR2_PACKAGE_PYTHON_SCAPY3K=y
BR2_PACKAGE_PYTHON_SH=y
BR2_PACKAGE_PYTHON_TOML=y
BR2_PACKAGE_PYTHON_SIX=y
BR2_PACKAGE_PYTHON_URLLIB3=y



BR2_PACKAGE_VIM=y
BR2_PACKAGE_WGET=y
BR2_PACKAGE_OPKG=y
BR2_PACKAGE_PYTHON_SETUPTOOLS=y
BR2_SYSTEM_BIN_SH_BASH=y
BR2_SYSTEM_BIN_SH="bash"
BR2_TARGET_ROOTFS_EXT2_BLOCKS=512000
BR2_PACKAGE_CTAGS=y ## Done!
## ffmpeg part ##
BR2_PACKAGE_FFMPEG=y
BR2_PACKAGE_FFMPEG_FFMPEG=y
BR2_PACKAGE_FFMPEG_FFPLAY=y

## compressors & decompressors
BR2_PACKAGE_P7ZIP=y
BR2_PACKAGE_UNRAR=y
BR2_PACKAGE_UNZIP=y
BR2_PACKAGE_XZ=y
BR2_PACKAGE_ZIP=y
BR2_PACKAGE_BZIP2=y

## Development tools ##
BR2_PACKAGE_FLEX=y
BR2_PACKAGE_GAWK=y
BR2_PACKAGE_GIT=y
BR2_PACKAGE_GIT_CRYPT=y
BR2_PACKAGE_GREP=y
BR2_PACKAGE_LIBTOOL=y
BR2_PACKAGE_MAKE=y
BR2_PACKAGE_PATCH=y
BR2_PACKAGE_PKGCONF=y
BR2_PACKAGE_SED=y
BR2_PACKAGE_SUBVERSION=y
BR2_PACKAGE_TREE=y

## Filesystem tool ##
BR2_PACKAGE_E2TOOLS=y

## Graphic libraries ##
BR2_PACKAGE_SDL2=y

## Crypto ##
BR2_PACKAGE_OPENSSL=y
BR2_PACKAGE_OPENSSL_BIN=y
BR2_PACKAGE_OPENSSL_ENGINES=y
BR2_PACKAGE_LIBMHASH=y
BR2_PACKAGE_LIBSHA1=y
BR2_PACKAGE_LIBSSH=y
BR2_PACKAGE_LIBSSH2=y


## sqlcipher conflicts with sqlite ##
BR2_PACKAGE_SQLITE=y

## Other ##
BR2_PACKAGE_APR=y
BR2_PACKAGE_APR_UTIL=y
BR2_PACKAGE_LIBXML2=y
BR2_PACKAGE_LIBXSLT=y
BR2_PACKAGE_BC=y
BR2_PACKAGE_CTORRENT=y
BR2_PACKAGE_DHCP=y
BR2_PACKAGE_DHCP_CLIENT=y
BR2_PACKAGE_DHCPCD=y
BR2_PACKAGE_MPDECIMAL=y

## Security ##
BR2_PACKAGE_LIBSELINUX=y
BR2_PACKAGE_LIBSEPOL=y

## Text & Terminal handling ##
BR2_PACKAGE_PCRE=y

## Networking ##
BR2_PACKAGE_OPENSSH=y
BR2_PACKAGE_WHOIS=y
BR2_PACKAGE_LIBCURL=y
BR2_PACKAGE_CURL=y
BR2_PACKAGE_TFTPD=y

## Shell ##
BR2_PACKAGE_ZSH=y

## Utilities ##
BR2_PACKAGE_FILE=y
BR2_PACKAGE_WHICH=y
BR2_PACKAGE_TIME=y

## System tools ##
BR2_PACKAGE_ANDROID_TOOLS=y
BR2_PACKAGE_ANDROID_TOOLS_FASTBOOT_GOOD_KERNEL_HEADERS=y
BR2_PACKAGE_ANDROID_TOOLS_FASTBOOT=y
BR2_PACKAGE_ANDROID_TOOLS_ADB=y
BR2_PACKAGE_ANDROID_TOOLS_ADBD=y

## supervisor needs the python interpreter ##
BR2_PACKAGE_TAR=y
BR2_PACKAGE_UTIL_LINUX=y
BR2_PACKAGE_UTIL_LINUX_LIBBLKID=y
BR2_PACKAGE_UTIL_LINUX_LIBMOUNT=y
BR2_PACKAGE_UTIL_LINUX_LIBUUID=y
BR2_PACKAGE_UTIL_LINUX_FSCK=y
BR2_PACKAGE_UTIL_LINUX_KILL=y
BR2_PACKAGE_UTIL_LINUX_LAST=y

## Text editor & Viewers ##
BR2_PACKAGE_LESS=y

## X window & Graphic reference things ##
# Cursors
BR2_PACKAGE_COMIX_CURSORS=y

# Icons
BR2_PACKAGE_GOOGLE_MATERIAL_DESIGN_ICONS=y
BR2_PACKAGE_GOOGLE_MATERIAL_DESIGN_ICONS_TYPE_PNG=y
BR2_PACKAGE_GOOGLE_MATERIAL_DESIGN_ICONS_TYPE_SVG=y
BR2_PACKAGE_GOOGLE_MATERIAL_DESIGN_ICONS_FONT=y
BR2_PACKAGE_GOOGLE_MATERIAL_DESIGN_ICONS_SPRITES_CSS=y
BR2_PACKAGE_GOOGLE_MATERIAL_DESIGN_ICONS_SPRITES_SVG=y
BR2_PACKAGE_HICOLOR_ICON_THEME=y

# Themes
BR2_PACKAGE_GTK2_ENGINES=y

# Graphic libraries
BR2_PACKAGE_SDL2=y
BR2_PACKAGE_SDL2_X11=y
BR2_PACKAGE_SDL2_GFX=y
BR2_PACKAGE_SDL2_IMAGE=y
BR2_PACKAGE_SDL2_TTF=y

# GUI
BR2_PACKAGE_XORG7=y

## X11R7 Servers
BR2_PACKAGE_XSERVER_XORG_SERVER=y
BR2_PACKAGE_XSERVER_XORG_SERVER_VIDEODRV_ABI_23=y
BR2_PACKAGE_XSERVER_XORG_SERVER_VIDEODRV_ABI=23
BR2_PACKAGE_XSERVER_XORG_SERVER_V_1_19=y
BR2_PACKAGE_XSERVER_XORG_SERVER_VERSION="1.19.3"
BR2_PACKAGE_XSERVER_XORG_SERVER_MODULAR=y

## Optional Servers
BR2_PACKAGE_XSERVER_XORG_SERVER_XVFB=y

## X11R7 Libraries
BR2_PACKAGE_LIBXCB=y
BR2_PACKAGE_XLIB_LIBFS=y
BR2_PACKAGE_XLIB_LIBICE=y
BR2_PACKAGE_XLIB_LIBSM=y
BR2_PACKAGE_XLIB_LIBX11=y
BR2_PACKAGE_XLIB_LIBXAU=y
BR2_PACKAGE_XLIB_LIBXAW=y
BR2_PACKAGE_XLIB_LIBXCOMPOSITE=y
BR2_PACKAGE_XLIB_LIBXCURSOR=y
BR2_PACKAGE_XLIB_LIBXDAMAGE=y
BR2_PACKAGE_XLIB_LIBXDMCP=y
BR2_PACKAGE_XLIB_LIBXEXT=y
BR2_PACKAGE_XLIB_LIBXFIXES=y
BR2_PACKAGE_XLIB_LIBXFONT2=y
BR2_PACKAGE_XLIB_LIBXFT=y
BR2_PACKAGE_XLIB_LIBXI=y
BR2_PACKAGE_XLIB_LIBXINERAMA=y
BR2_PACKAGE_XLIB_LIBXMU=y
BR2_PACKAGE_XLIB_LIBXPM=y
BR2_PACKAGE_XLIB_LIBXRANDR=y
BR2_PACKAGE_XLIB_LIBXRENDER=y
BR2_PACKAGE_XLIB_LIBXRES=y
BR2_PACKAGE_XLIB_LIBXT=y
BR2_PACKAGE_XLIB_LIBXTST=y
BR2_PACKAGE_XLIB_LIBXV=y
BR2_PACKAGE_XLIB_LIBXXF86VM=y
BR2_PACKAGE_XLIB_LIBFONTENC=y
BR2_PACKAGE_XLIB_LIBXKBFILE=y
BR2_PACKAGE_XLIB_XTRANS=y

## X11R7 Applications
BR2_PACKAGE_XAPP_BITMAP=y
BR2_PACKAGE_XAPP_LUIT=y
BR2_PACKAGE_XAPP_RGB=y
BR2_PACKAGE_XAPP_RSTART=y
BR2_PACKAGE_XAPP_SCRIPTS=y
BR2_PACKAGE_XAPP_SESSREG=y
BR2_PACKAGE_XAPP_SHOWFONT=y
BR2_PACKAGE_XAPP_VIEWRES=y
BR2_PACKAGE_XAPP_XAUTH=y
BR2_PACKAGE_XAPP_XCALC=y
BR2_PACKAGE_XAPP_XCLIPBOARD=y
BR2_PACKAGE_XAPP_XCLOCK=y
BR2_PACKAGE_XAPP_XCONSOLE=y
BR2_PACKAGE_XAPP_XDITVIEW=y
BR2_PACKAGE_XAPP_XDPYINFO=y
BR2_PACKAGE_XAPP_XEDIT=y
BR2_PACKAGE_XAPP_XFD=y
BR2_PACKAGE_XAPP_XFONTSEL=y
BR2_PACKAGE_XAPP_XGC=y
BR2_PACKAGE_XAPP_XHOST=y
BR2_PACKAGE_XAPP_XINIT=y
BR2_PACKAGE_XAPP_XINPUT=y
BR2_PACKAGE_XAPP_XKBCOMP=y
BR2_PACKAGE_XAPP_XKBEVD=y
BR2_PACKAGE_XAPP_XKBPRINT=y
BR2_PACKAGE_XAPP_XKBUTILS=y
BR2_PACKAGE_XAPP_XLOAD=y
BR2_PACKAGE_XAPP_XLOGO=y
BR2_PACKAGE_XAPP_XMAG=y
BR2_PACKAGE_XAPP_XMAN=y
BR2_PACKAGE_XAPP_XMESSAGE=y
BR2_PACKAGE_XAPP_XMODMAP=y
BR2_PACKAGE_XAPP_XMORE=y
BR2_PACKAGE_XAPP_XRDB=y
BR2_PACKAGE_XAPP_XSET=y
BR2_PACKAGE_XAPP_XSETMODE=y
BR2_PACKAGE_XAPP_XSETPOINTER=y
BR2_PACKAGE_XAPP_XSETROOT=y
BR2_PACKAGE_XAPP_XSM=y
BR2_PACKAGE_XAPP_XSTDCMAP=y
BR2_PACKAGE_XAPP_XVIDTUNE=y
BR2_PACKAGE_XAPP_XVINFO=y
BR2_PACKAGE_XAPP_XWD=y
BR2_PACKAGE_XAPP_XWININFO=y
BR2_PACKAGE_XAPP_XWUD=y

## X11R7 Drivers
BR2_PACKAGE_XDRIVER_XF86_INPUT_KEYBOARD=y
BR2_PACKAGE_XDRIVER_XF86_INPUT_MOUSE=y
BR2_PACKAGE_XDRIVER_XF86_VIDEO_FBDEV=y

## X11R7 Fonts
BR2_PACKAGE_XFONT_FONT_UTIL=y
BR2_PACKAGE_XFONT_ENCODINGS=y
BR2_PACKAGE_XFONT_FONT_ADOBE_100DPI=y
BR2_PACKAGE_XFONT_FONT_ADOBE_75DPI=y
BR2_PACKAGE_XFONT_FONT_ALIAS=y
BR2_PACKAGE_XFONT_FONT_BH_100DPI=y
BR2_PACKAGE_XFONT_FONT_BH_75DPI=y
BR2_PACKAGE_XFONT_FONT_BH_TTF=y
BR2_PACKAGE_XFONT_FONT_BH_TYPE1=y
BR2_PACKAGE_XFONT_FONT_BITSTREAM_100DPI=y
BR2_PACKAGE_XFONT_FONT_BITSTREAM_75DPI=y
BR2_PACKAGE_XFONT_FONT_BITSTREAM_TYPE1=y
BR2_PACKAGE_XFONT_FONT_CURSOR_MISC=y
BR2_PACKAGE_XFONT_FONT_MISC_MISC=y
BR2_PACKAGE_XFONT_FONT_XFREE86_TYPE1=y

## X11R7 X protocols
BR2_PACKAGE_XCB_PROTO=y
BR2_PACKAGE_XPROTO_BIGREQSPROTO=y
BR2_PACKAGE_XPROTO_COMPOSITEPROTO=y
BR2_PACKAGE_XPROTO_DAMAGEPROTO=y
BR2_PACKAGE_XPROTO_DRI2PROTO=y
BR2_PACKAGE_XPROTO_FIXESPROTO=y
BR2_PACKAGE_XPROTO_FONTSPROTO=y
BR2_PACKAGE_XPROTO_GLPROTO=y
BR2_PACKAGE_XPROTO_INPUTPROTO=y
BR2_PACKAGE_XPROTO_KBPROTO=y
BR2_PACKAGE_XPROTO_PRESENTPROTO=y
BR2_PACKAGE_XPROTO_RANDRPROTO=y
BR2_PACKAGE_XPROTO_RECORDPROTO=y
BR2_PACKAGE_XPROTO_RENDERPROTO=y
BR2_PACKAGE_XPROTO_RESOURCEPROTO=y
BR2_PACKAGE_XPROTO_VIDEOPROTO=y
BR2_PACKAGE_XPROTO_XCMISCPROTO=y
BR2_PACKAGE_XPROTO_XEXTPROTO=y
BR2_PACKAGE_XPROTO_XF86BIGFONTPROTO=y
BR2_PACKAGE_XPROTO_XF86DGAPROTO=y
BR2_PACKAGE_XPROTO_XF86DRIPROTO=y
BR2_PACKAGE_XPROTO_XF86VIDMODEPROTO=y
BR2_PACKAGE_XPROTO_XINERAMAPROTO=y
BR2_PACKAGE_XPROTO_XPROTO=y

## X11R7 Utilities
BR2_PACKAGE_XUTIL_MAKEDEPEND=y
BR2_PACKAGE_MCOOKIE=y

## X11R7 Other data
BR2_PACKAGE_XDATA_XBITMAPS=y
BR2_PACKAGE_XDATA_XCURSOR_THEMES=y
BR2_PACKAGE_XCURSOR_TRANSPARENT_THEME=y

## X applications
BR2_PACKAGE_DILLO=y
BR2_PACKAGE_DOCKER=y
BR2_PACKAGE_FEH=y
BR2_PACKAGE_GMPC=y
BR2_PACKAGE_GQVIEW=y
BR2_PACKAGE_GTKPERF=y
BR2_PACKAGE_LEAFPAD=y
BR2_PACKAGE_PCMANFM=y
BR2_PACKAGE_RDESKTOP=y
BR2_PACKAGE_SYNERGY=y
BR2_PACKAGE_WMCTRL=y
BR2_PACKAGE_X11VNC=y
BR2_PACKAGE_XDOTOOL=y
BR2_PACKAGE_XSCREENSAVER=y
BR2_PACKAGE_XTERM=y
BR2_PACKAGE_XVKBD=y

## X libraries and helper libraries
BR2_PACKAGE_LIBSEXY=y
BR2_PACKAGE_XKEYBOARD_CONFIG=y

## X window managers
BR2_PACKAGE_MATCHBOX=y
BR2_PACKAGE_MATCHBOX_SM=y

### matchbox utilities
BR2_PACKAGE_MATCHBOX_COMMON=y
BR2_PACKAGE_MATCHBOX_COMMON_PDA=y
BR2_PACKAGE_MATCHBOX_DESKTOP=y
BR2_PACKAGE_MATCHBOX_FAKEKEY=y
BR2_PACKAGE_MATCHBOX_KEYBOARD=y
BR2_PACKAGE_MATCHBOX_LIB=y
BR2_PACKAGE_MATCHBOX_PANEL=y
BR2_PACKAGE_MATCHBOX_STARTUP_MONITOR=y

# Graphics
BR2_PACKAGE_ATK=y          # selected by libgtk2   ATK - Accessibility Toolkit GNOME provides support for accessibility devices using the ATK framework. 
                           # This framework defines a set of interfaces to which graphical interface components adhere. 
BR2_PACKAGE_CAIRO=y        # Cairo is a 2D graphics library with support for multiple output devices. 
BR2_PACKAGE_CAIRO_PS=y
BR2_PACKAGE_CAIRO_PDF=y
BR2_PACKAGE_CAIRO_PNG=y
BR2_PACKAGE_CAIRO_SCRIPT=y
BR2_PACKAGE_CAIRO_SVG=y
BR2_PACKAGE_CAIRO_TEE=y
BR2_PACKAGE_CAIRO_XML=y
BR2_PACKAGE_FLTK=y         # FLTK (pronounced "fulltick") is a cross-platform C++ GUI toolkit for UNIX®/Linux® (X11), 
BR2_PACKAGE_FONTCONFIG=y   # Fontconfig is a library for configuring and customizing font access. 
BR2_PACKAGE_FREETYPE=y     # FreeType is a freely available software library to render fonts.
BR2_PACKAGE_GDK_PIXBUF=y   # GdkPixbuf is a library for image loading and manipulation.
BR2_PACKAGE_GIFLIB=y       # the giflib service library, which has been pulling images out of GIFs since 1989
BR2_PACKAGE_HARFBUZZ=y     # HarfBuzz is an OpenType text shaping engine

BR2_PACKAGE_IMLIB2=y       # Imlib2 is a graphics library for fast file loading, saving, rendering and manipulation.
BR2_PACKAGE_IMLIB2_JPEG=y
BR2_PACKAGE_IMLIB2_PNG=y
BR2_PACKAGE_IMLIB2_GIF=y
BR2_PACKAGE_IMLIB2_TIFF=y
BR2_PACKAGE_IMLIB2_ID3=y
BR2_PACKAGE_IMLIB2_X=y
BR2_PACKAGE_JPEG=y         # Joint Photographic Experts Group. A platform independent high efficiency compression format
BR2_PACKAGE_LIBJPEG=y
BR2_PACKAGE_HAS_JPEG=y
BR2_PACKAGE_LIBDRM=y       # libdrm provides a user space library for accessing the DRM, direct rendering manager, on operating systems that support the ioctl interface. 
BR2_PACKAGE_LIBDRM_HAS_ATOMIC=y
BR2_PACKAGE_LIBFM=y        # Factorization machines (FM) are a generic approach that allows to mimic most factorization models by feature engineering.
BR2_PACKAGE_LIBFM_EXTRA=y   
BR2_PACKAGE_LIBGLADE=y     # Libglade is a library that performs a similar job to the C source output routines in the GLADE user interface builder.
BR2_PACKAGE_LIBGTK2=y      # GTK+, or the GIMP Toolkit, is a multi-platform toolkit for creating graphical user interfaces. 
BR2_PACKAGE_LIBGTK2_DEMO=y
BR2_PACKAGE_LIBPNG=y       # libpng is the official PNG reference library.
BR2_PACKAGE_MENU_CACHE=y   # Libmenu-cache is a library creating and utilizing caches to speed up the manipulation for freedesktop.org defined application menus.
BR2_PACKAGE_PANGO=y        # Pango is a library for laying out and rendering of text, with an emphasis on internationalization. 
BR2_PACKAGE_PIXMAN=y       # Pixman is a low-level software library for pixel manipulation, providing features such as image compositing and trapezoid rasterization.
BR2_PACKAGE_TIFF=y         # Tag Image File Format ref things
BR2_PACKAGE_TIFF_CCITT=y
BR2_PACKAGE_TIFF_PACKBITS=y
BR2_PACKAGE_TIFF_LZW=y
BR2_PACKAGE_TIFF_THUNDER=y
BR2_PACKAGE_TIFF_NEXT=y
BR2_PACKAGE_TIFF_LOGLUV=y
BR2_PACKAGE_TIFF_MDI=y
BR2_PACKAGE_TIFF_ZLIB=y
BR2_PACKAGE_TIFF_PIXARLOG=y
BR2_PACKAGE_TIFF_JPEG=y
BR2_PACKAGE_TIFF_OLD_JPEG=y
BR2_PACKAGE_TIFF_JBIG=y
BR2_PACKAGE_WAYLAND=y      # Wayland is intended as a simpler replacement for X, easier to develop and maintain.
BR2_PACKAGE_WAYLAND_PROTOCOLS=y
BR2_PACKAGE_LIBPCIACCESS=y # libpciaccess.so is the generic PCI Access library for X
BR2_PACKAGE_LIBXKBCOMMON=y # xkbcommon is a library to handle keyboard descriptions, including loading them from disk, parsing them and handling their state.
BR2_PACKAGE_LIBSOUP=y      # The libsoup is a HTTP client/server library for GNOME.
BR2_PACKAGE_LIBGLIB2=y     # The GLib package contains low-level libraries useful for providing data structure handling for C, 
                           # portability wrappers and interfaces for such runtime functionality as an event loop, threads, dynamic loading and an object system. 
BR2_PACKAGE_LIBPTHREAD_STUBS=y     # This library provides weak aliases for pthread functions not provided in libc or otherwise available by default.
BR2_PACKAGE_LINUX_PAM=y    # Linux-PAM is a free implementation of the following DCE-RFC from Sunsoft. 
                           # PAM = Pluggable Authentication Modules 
                           # Basically, it is a flexible mechanism for authenticating users. 
BR2_PACKAGE_STARTUP_NOTIFICATION=y   # Monitor and display application startup
BR2_PACKAGE_PCRE_UTF=y     # The PCRE library is a set of functions that implement regular expression pattern matching using the same syntax and semantics as Perl 5. 
BR2_PACKAGE_PCRE_UCP=y     
BR2_PACKAGE_XUTIL_UTIL_MACROS=y   # The util-macros package contains the m4 macros used by all of the Xorg packages. 
```

## package/ctags/Config.in
```kconfig
config BR2_PACKAGE_CTAGS
	bool "ctags"
	depends on BR2_PACKAGE_BUSYBOX_SHOW_OTHERS
	help
          Ctags generates an index (or tag) file of language objects
          found in source files that allows these items to be quickly
          and easily located by a text editor or other utility.
```
